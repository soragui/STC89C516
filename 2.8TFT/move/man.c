#include <reg52.h>
#include <math.h>
#include "initLCD.h"

#define White          0xFFFF   //LCD color
#define Black          0x0000
#define Blue           0x001F
#define Blue2          0x051F
#define Red            0xF800
#define Magenta        0xF81F
#define Green          0x07E0
#define Cyan           0x7FFF
#define Yellow         0xFFE0

//#define PI 3.14159
unsigned char code ch[] = {
0x00,0x00,0x00,0x00,0x00,0x00,0x00,0x00,0x00,0x00,0x00,0x00,0x01,0xC0,0x00,0x00,
0x03,0xA0,0x01,0x40,0x00,0x80,0x00,0x84,0x30,0x82,0x2C,0x86,0x43,0xE4,0x60,0xB4,
0x20,0x9C,0x20,0x80,0x00,0x80,0x00,0xC0,0x81,0x60,0x61,0x30,0x72,0x1C,0x0C,0x08,
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0x39,0x04,0x1A,0x04,0x1C,0x18,0x00,0x10,0x00,0x30,0x00,0x00,0x00,0x00,0x00,0x00
};

void put_c(unsigned short x, unsigned short  y, unsigned int p, unsigned int fColor,unsigned int bColor);

unsigned int Device_code; 

void main()
{
	unsigned int k;
	Device_code=0x9328;                
    TFT_Initial();
	CLR_Screen(Black);
	/*for(i = 60; i < 110; i += 4)
	{
		circle(i, 160, 10, 0xEDF0);
		circle(i + 20, 160, 10, 0xEDF0);
		delayms(10);
		circle(i, 160, 10, Black);
		circle(i + 20, 160, 10, Black);
	} */
	while(1)
	{
		for(k = 60; k < 200; k += 6)
		{
			put_c(k, 120, 0, Cyan, Black);
			//put_c(k + 30, 120, Cyan, Black);
			delayms(120);
			put_c(k, 120, 0, Black, Black);
			put_c(k, 120, 1, Cyan, Black);
			//put_c(k + 30, 120, Cyan, Black);
			delayms(120);
			put_c(k, 120, 1, Black, Black);
			//put_c(k + 30, 120, Black, Black);	
		}
	}
	
	//while(1);
}

void put_c(unsigned short x, unsigned short  y, unsigned int p, unsigned int fColor,unsigned int bColor)
{
	unsigned int i,j;
	LCD_SetPos(x,  x+16-1,y, y+32-1);

	for(i=0;i<64;i++)                                   //如果相等，既已找到待显示字模位置，循环写入32字节
		{
		  unsigned short m=ch[i+p*16];                 //读取32字节中的第i字节
		  for(j=0;j<8;j++)                                  //循环写入8位数据
		   {                                                
			 if((m&0x80)==0x80) Write_Data_U16(fColor);     //判断最高位是否为1,最高位为1，写入字符颜色
			 else              Write_Data_U16(bColor);      //最高位为0，写入背景颜色
		     m<<=1;                                         //左移1位，准备写下一位
	       } 
		}
}